//Demo LCD12864 spi
//www.dfrobot.com

unsigned char logo0[]={                                         //笑脸
      0x00,0x00,0x00,0x00,0x00,0x00,0x00,0x00,
      0x00,0x00,0x00,0x00,0x00,0x00,0x00,0x00,
      0x00,0x00,0x00,0x00,0x00,0x00,0x00,0x00,
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      0x00,0x00,0x00,0x00,0x00,0x00,0x00,0x00
};


static const int latchPin = 8; 
static const int clockPin = 3;  
static const int dataPin = 9;  


//*********************延时函数************************//
void delayns(void)
{   
delayMicroseconds(80);
 }


void WriteByte(int dat)
{
    digitalWrite(latchPin, HIGH);
    delayns();
    shiftOut(dataPin, clockPin, MSBFIRST, dat);
    digitalWrite(latchPin, LOW);
}


void WriteCommand(int CMD)
{
   int H_data,L_data;
   H_data = CMD;
   H_data &= 0xf0;           //屏蔽低4位的数据
   L_data = CMD;             //xxxx0000格式
   L_data &= 0x0f;           //屏蔽高4位的数据
   L_data <<= 4;             //xxxx0000格式
   WriteByte(0xf8);          //RS=0，写入的是指令；
   WriteByte(H_data);
   WriteByte(L_data);
}


void WriteData(int CMD)
{
   int H_data,L_data;
   H_data = CMD;
   H_data &= 0xf0;           //屏蔽低4位的数据
   L_data = CMD;             //xxxx0000格式
   L_data &= 0x0f;           //屏蔽高4位的数据
   L_data <<= 4;             //xxxx0000格式
   WriteByte(0xfa);          //RS=1，写入的是数据
   WriteByte(H_data);
   WriteByte(L_data);
}



void Initialise()
{
    pinMode(latchPin, OUTPUT);     
    pinMode(clockPin, OUTPUT);    
    pinMode(dataPin, OUTPUT);
    digitalWrite(latchPin, LOW);
    delayns();

    WriteCommand(0x30);        //功能设定控制字
    WriteCommand(0x0c);        //显示开关控制字
    WriteCommand(0x01);        //清除屏幕控制字
    WriteCommand(0x06);        //进入设定点控制字
}


void CLEAR(void)
{  
    WriteCommand(0x30);//
    WriteCommand(0x01);//清除显示
}


void DisplayString(int X,int Y,unsigned char *ptr,int dat)
{
  int i;

  switch(X)
   {
     case 0:  Y|=0x80;break;

     case 1:  Y|=0x90;break;

     case 2:  Y|=0x88;break;

     case 3:  Y|=0x98;break;

     default: break;
   }
  WriteCommand(Y); // 定位显示起始地址

  for(i=0;i<dat;i++)
    { 
      WriteData(ptr[i]);//显示汉字时注意码值，连续两个码表示一个汉字
    }
}



void DisplaySig(int M,int N,int sig)
{
  switch(M)
   {
     case 0:  N|=0x80;break;

     case 1:  N|=0x90;break;

     case 2:  N|=0x88;break;

     case 3:  N|=0x98;break;

     default: break;
   }
  WriteCommand(N); // 定位显示起始地址
  WriteData(sig); //输出单个字符
 }




void DrawFullScreen(unsigned char *p)
{
      int ygroup,x,y,i;
      int temp;
      int tmp;
             
      for(ygroup=0;ygroup<64;ygroup++)           //写入液晶上半图象部分
        {                           //写入坐标
           if(ygroup<32)
            {
             x=0x80;
             y=ygroup+0x80;
            }
           else 
            {
              x=0x88;
              y=ygroup-32+0x80;    
            }         
           WriteCommand(0x34);        //写入扩充指令命令
           WriteCommand(y);           //写入y轴坐标
           WriteCommand(x);           //写入x轴坐标
           WriteCommand(0x30);        //写入基本指令命令
           tmp=ygroup*16;
           for(i=0;i<16;i++)
		 {
		    temp=p[tmp++];
		    WriteData(temp);
               }
          }
        WriteCommand(0x34);        //写入扩充指令命令
        WriteCommand(0x36);        //显示图象
}

void UpdateLine(int ygroup,unsigned char *p)
{
      int x,y,i;
      int temp;
      int tmp;
                                     //写入坐标
           if(ygroup<32)
            {
             x=0x80;
             y=ygroup+0x80;
            }
           else 
            {
              x=0x88;
              y=ygroup-32+0x80;    
            }         
           WriteCommand(0x34);        //写入扩充指令命令
           WriteCommand(y);           //写入y轴坐标
           WriteCommand(x);           //写入x轴坐标
           WriteCommand(0x30);        //写入基本指令命令
           tmp=ygroup*16;
           for(i=0;i<16;i++)
		 {
		    temp=p[tmp++];
		    WriteData(temp);
               }
          
        WriteCommand(0x34);        //写入扩充指令命令
        WriteCommand(0x36);        //显示图象
}

void Dot(unsigned char X, unsigned char Y, unsigned int temp)
{
	if(X > 7 || Y > 63) return;  //点超出显示范围处理	
	//坐标转换（原点从左上角转换到左下角）
	Y = 63-Y;	
	if(Y<32)
	{
		X = X + 0x80;
		Y = Y + 0x80;
	}
	else
	{
		X = X + 0x88;
		Y = Y - 32 + 0x80;
	}

	WriteCommand(0x34);  //写入扩充指令命令
	WriteCommand(Y);     //写入y轴坐标
	WriteCommand(X);     //写入x轴坐标
	WriteCommand(0x30);  //写入基本指令命令
	WriteData(temp>>8);  //写入数据
	WriteData(temp);     //写入数据
        WriteCommand(0x34);  //写入扩充指令命令
        WriteCommand(0x36);        //显示图象
}





#define AR_SIZE( a ) sizeof( a ) / sizeof( a[0] )
 
unsigned char show0[]={0xBC,0xAB,0xBF,0xCD,0xB9,0xA4,0xB7,0xBB};//极客工坊
unsigned char show1[]="geek-workshop";


void setup()
{
Initialise(); // 屏幕初始化
delay(100);
}
 
void loop()
{
CLEAR();//清屏
unsigned char hj[]="Hejia ist ein SB";
delay(100);
DisplayString(0,2,show0,AR_SIZE(show0));//第一行第三格开始，显示文字极客工坊
delay(100);
DisplayString(2,1,hj,AR_SIZE(hj));;//第三行第二格开始，显示文字geek-workshop
delay(1000);
//unsigned int bland=0x00FF;
//Dot(60,5,bland);
//delay(5000);
unsigned char ll[1024];
DrawFullScreen(logo0);
delay(1000);


}

